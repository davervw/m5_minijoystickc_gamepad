// ble_gamepad_M5MiniJoyStickC+ - HID BLE Gamepad firmware for M5Stack MiniJoyC and StickC+ hardware
//
// Copyright (c) 2026 by David Van Wagner
//
// MIT License
//
// github.com/davervw
// davevw.com
//
// Credit to examples for librarys used in this project, and their examples.  Plenty of code is borrowed.

#include <Arduino.h>
#include <M5Unified.h>
#include <BleGamepad.h>
#include <WiFi.h>
#include <M5HatMiniJoyC.h>

// M5Stick-C Hat slot I2C Pins
#define JOYC_SDA 0
#define JOYC_SCL 26

enum ButtonState
{
    UNKNOWN = -1,
    NONE = 0,
    A = 1,
    B = 2,
    UP = 4,
    DOWN = 8,
    LEFT = 16,
    RIGHT = 32,
};

M5HatMiniJoyC joyc; // Joystick object
BleGamepad bleGamepad("M5MiniJoyC Gamepad", "davevw.com", 100);
BleGamepadConfiguration bleGamepadConfig;
ButtonState lastState = ButtonState::UNKNOWN;

static void waitMiniJoyCReady() // from https://github.com/m5stack/StackChan/blob/main/remote/code/main/StackChan-RemoteControl-ESPNow.cpp
{
    while (!joyc.begin(&Wire, MiniJoyC_ADDR, JOYC_SDA, JOYC_SCL,
                       100000UL))
    {
        delay(100); // Retry every 100ms
    }
}

void drawImage()
{
    int imgW = 91;
    int imgH = 183;
    const uint8_t image_91x183[] = {
        0x00, 0x00, 0x00, 0x00, 0x00, 0xff, 0xff, 0x00, 0x00, 0x00, 0x00, 0x00,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 0x00, 0x00};

    int x = (M5.Display.width() - imgW) / 2;
    int y = 20; // (M5.Display.height() - imgH) / 2;

    M5.Display.drawXBitmap(x, y, image_91x183, imgW, imgH, TFT_BLACK);
}

class MyGamepadCallbacks : public NimBLEServerCallbacks
{
    void onConnect(NimBLEServer *pServer) {
        // Serial.println(">> Callback: Device Connected!");
    };

    void onDisconnect(NimBLEServer *pServer)
    {
        // Serial.println(">> Callback: Device Disconnected! Restarting advertising...");
        //  Re-advertising is typically handled by the library, but you can trigger custom logic here
    }
};

void toggleScreen()
{
    static bool showScreen = false;

    showScreen = !showScreen;

    if (showScreen) {
        M5.Display.beginTransaction();
        M5.Display.setRotation(1);
        M5.Display.fillRect(0, 16, M5.Display.width(), M5.Display.height()-16, TFT_WHITE);
        drawImage();
        M5.Display.setCursor(0, 0);
        M5.Display.fillRect(0, 0, M5.Display.width()-32, 16, TFT_BLACK);
        M5.Display.setTextColor(TFT_WHITE);
        M5.Display.setFont(&lv_font_montserrat_12);
        M5.Display.print("ble_gamepad_M5MiniJoyStickC+");
        M5.Display.setCursor(0, 16);
        M5.Display.setTextColor(TFT_BLACK);
        M5.Display.setFont(&lv_font_montserrat_14);
        M5.Display.print("davevw.com");
        M5.Display.endTransaction();
    } else {
        M5.Display.fillRect(0, 16, M5.Display.width(), M5.Display.height()-16, TFT_BLACK);
    }
}

void setup()
{
    WiFi.disconnect();
    delay(100);
    WiFi.mode(WIFI_MODE_NULL);

    m5::M5Unified::config_t cfg;
    memset(&cfg, 0, sizeof(cfg));
    M5.begin(cfg);

    waitMiniJoyCReady();

    M5.Display.fillScreen(TFT_BLACK);
    toggleScreen();

    // --- HID Report Map Configuration ---
    bleGamepadConfig.setAutoReport(false); // Best practice: manual reports
    bleGamepadConfig.setButtonCount(2);    // Button 1 (A), 2 (B)
    bleGamepadConfig.setHatSwitchCount(1); // One D-pad (Point of View Hat)

    // Parameters: (X, Y, Z, RX, RY, RZ, Slider1, Slider2)
    bleGamepadConfig.setWhichAxes(true, true, false, false, false, false, false, false);

    bleGamepadConfig.setControllerType(CONTROLLER_TYPE_GAMEPAD);

    // Apply the configuration
    bleGamepad.begin(&bleGamepadConfig);

    // Get the global advertising object
    NimBLEAdvertising *pAdvertising = NimBLEDevice::getAdvertising();

    // Add the HID Service UUID (0x1812) to the advertisement data
    pAdvertising->addServiceUUID(BLEUUID((uint16_t)0x1812));

    // Restart advertising to apply changes
    pAdvertising->start();

    // Serial.println("Started Custom BLE Gamepad Service");

    M5.Display.fillRect(M5.Display.width() - 16, 0, 16, 16, TFT_DARKORANGE);
}

void serviceBLE()
{
    bool isConnected = bleGamepad.isConnected();
    static bool wasConnected = false;

    // Detect JUST CONNECTED
    if (isConnected && !wasConnected)
    {
        // Serial.println(">> EVENT: Gamepad Connected to Host!");
        M5.Display.fillRect(M5.Display.width() - 16, 0, 16, 16, TFT_DARKGREEN);
        wasConnected = true;
    }

    // Detect JUST DISCONNECTED
    if (!isConnected && wasConnected)
    {
        // Serial.println(">> EVENT: Gamepad Disconnected!");
        M5.Display.fillRect(M5.Display.width() - 16, 0, 16, 16, TFT_DARKORANGE);
        wasConnected = false;
    }
}

void serviceLED()
{
    static long then = millis();
    static bool state = false;

    long now = millis();
    if ((now - then) >= 1000)
    {
        state = !state;
        if (state)
            M5.Display.fillRect(M5.Display.width() - 32, 0, 16, 16, TFT_DARKSLATEBLUE);
        else
            M5.Display.fillRect(M5.Display.width() - 32, 0, 16, 16, TFT_WHITE);
        then = now;
    }
}

void SendButtonState()
{
    const int updateInterval = 16;                     // ~60 updates per second
    static unsigned long lastUpdate = -updateInterval; // Initialize to allow immediate update on first run
    if (millis() - lastUpdate < updateInterval)
        return; // Skip update if interval hasn't passed
    lastUpdate = millis();

    auto state = 0;
    auto button1 = M5.BtnA.isPressed();
    auto button2 = !joyc.getButtonStatus();
    auto x = (short)joyc.getPOSValue(minijoyc_pos_index_t::POS_X, minijoyc_pos_read_mode_t::_10bit);
    auto y = (short)joyc.getPOSValue(minijoyc_pos_index_t::POS_Y, minijoyc_pos_read_mode_t::_10bit);
    // printf("button1: %d button2: %d x: %d y: %d\n", button1, button2, x, y);

    if (button1)
        state |= ButtonState::A;
    if (button2)
        state |= ButtonState::B;
    if (y >= 300)
        state |= ButtonState::LEFT;
    if (y <= -300)
        state |= ButtonState::RIGHT;
    if (x >= 300)
        state |= ButtonState::UP;
    if (x <= -300)
        state |= ButtonState::DOWN;
    auto buttonState = static_cast<ButtonState>(state);

    // Send button states to the connected BLE client
    if ((buttonState & ButtonState::A) == ButtonState::A)
        bleGamepad.press(1);
    else
        bleGamepad.release(1);
    if ((buttonState & ButtonState::B) == ButtonState::B)
        bleGamepad.press(2);
    else
        bleGamepad.release(2);

    signed char hatValue = DPAD_CENTERED;

    // Define the masks for readability
    bool up = (buttonState & ButtonState::UP);
    bool down = (buttonState & ButtonState::DOWN);
    bool left = (buttonState & ButtonState::LEFT);
    bool right = (buttonState & ButtonState::RIGHT);

    // 1. Handle Diagonals (High Priority)
    if (up && right)
        hatValue = DPAD_UP_RIGHT;
    else if (down && right)
        hatValue = DPAD_DOWN_RIGHT;
    else if (down && left)
        hatValue = DPAD_DOWN_LEFT;
    else if (up && left)
        hatValue = DPAD_UP_LEFT;

    // 2. Handle Cardinal Directions (Medium Priority)
    else if (up)
        hatValue = DPAD_UP;
    else if (down)
        hatValue = DPAD_DOWN;
    else if (left)
        hatValue = DPAD_LEFT;
    else if (right)
        hatValue = DPAD_RIGHT;

    // 3. Neutral (Handled by initialization)

    // int analogValue = analogRead(36);
    //  Serial.print("Analog value: ");
    //  Serial.println(analogValue);
    int mappedValueX = map(y, -512, 512, 32767, -32768);
    int mappedValueY = map(x, -512, 512, 32767, -32768);
    //  Serial.print("Mapped value: ");
    //  Serial.println(mappedValue);

    // 4. Update the specific axis value based on the paddle position
    bleGamepad.setX(mappedValueX);
    bleGamepad.setY(mappedValueY);

    // Also update the hat switch value based on the D-pad state
    bleGamepad.setHat1(hatValue);

    lastState = buttonState; // used by checkForReset to detect new reset events

    bleGamepad.sendReport();
}

void loop()
{
    serviceBLE();
    M5.update();
    if (M5.BtnB.wasReleasedAfterHold())
        toggleScreen();
    SendButtonState();
    serviceLED();
    delay(10);
}
